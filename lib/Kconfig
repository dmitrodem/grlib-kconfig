## lib/esa/Kconfig
```kconfig
menu "ESA config"

source esa/memoryctrl/Kconfig
source esa/pci/Kconfig

endmenu
```

## lib/esa/memoryctrl/Kconfig
```kconfig
menuconfig MCTRL_LEON2
    bool "Leon2 memory controller"
    default y
    help
    Say Y here to enable the LEON2 memory controller. The controller
    can access PROM, I/O, SRAM and SDRAM. The bus width for PROM
    and SRAM is programmable to 8-, 16- or 32-bits.
config MCTRL_8BIT
    bool "8-bit PROM/SRAM bus support"
    default y
    depends on MCTRL_LEON2
    help
    If you say Y here, the PROM/SRAM memory controller will support
    8-bit mode, i.e. operate from 8-bit devices as if they were 32-bit.
    Say N to save a few hundred gates.
config MCTRL_16BIT
    bool "16-bit PROM/SRAM bus support"
    default y
    depends on MCTRL_LEON2
    help
    If you say Y here, the PROM/SRAM memory controller will support
    16-bit mode, i.e. operate from 16-bit devices as if they were 32-bit.
    Say N to save a few hundred gates.
config MCTRL_5CS
    bool "5th SRAM chip-select"
    default n
    depends on MCTRL_LEON2
    help
    If you say Y here, the 5th (RAMSN[4]) SRAM chip select signal will
    be enabled. If you don't intend to use it, say N and save some gates.
menuconfig MCTRL_SDRAM
    bool "SDRAM controller"
    default n
    depends on MCTRL_LEON2
    help
    Say Y here to enabled the PC100/PC133 SDRAM controller. If you don't
    intend to use SDRAM, say N and save about 1 kgates.
config MCTRL_SDRAM_SEPBUS
    bool "Separate address and data buses"
    default n
    depends on MCTRL_SDRAM
    help
    Say Y here if your SDRAM is connected through separate address
    and data buses (SA & SD). This is the case on the GR-CPCI-XC2V6000
    board, but not on the GR-PCI-XC2V3000 or Avnet XCV1500E boards.
config MCTRL_SDRAM_BUS64
    bool "64-bit SDRAM data bus"
    default n
    depends on MCTRL_SDRAM_SEPBUS
    help
	Say Y here to enable 64-bit SDRAM data bus.
config MCTRL_SDRAM_INVCLK
    bool "Unsynchronized sdclock"
    default n
    depends on MCTRL_SDRAM_SEPBUS
    help
    If you say Y here, the SDRAM controller output signals will be delayed
    with 1/2 clock in respect to the SDRAM clock. This will allow the used
    of an SDRAM clock which in not strictly in phase with the internal
    clock. This option will limit the SDRAM frequency to 40 - 50 MHz.

    On FPGA targets without SDRAM clock synchronizations through PLL/DLL, 
    say Y. On ASIC targets, say N and tell your foundry to balance the 
    SDRAM clock output.
config MCTRL_PAGE
    bool "Enable page burst operation"
    default y
    depends on MCTRL_SDRAM
    help
	Say Y here to enable SDRAM page burst operation. This will implement
  	read operations using page bursts rather than 8-word bursts and save
  	about 500 gates (100 LUTs). Note that not all SDRAM supports page 
  	burst, so use this option with care.
config MCTRL_PROGPAGE
    bool "Enable programmable page burst"
    default y
    depends on MCTRL_PAGE
    help
    Say Y here to enable programmable SDRAM page burst operation. This
    will allow to dynamically enable/disable page burst by setting
    bit 17 in MCFG2.
```

## lib/esa/pci/Kconfig
```kconfig
menu "PCI config"

config PCI_ARBITER
    bool "PCI arbiter"
    default n
    help
	To enable a PCI arbiter, say Y here.
config PCI_ARBITER_APB
    bool "PCI arbiter APB interface"
    default n
    depends on PCI_ARBITER
    help
        Say Y here to enable the APB interface on the PCI arbiter. This makes
  	it possible to dynamically re-assign PCI master priorities. See the
  	PCI arbiter manual for details.
config PCI_ARBITER_NREQ
    int "Number of PCI REQ/GNT pairs"
    default 4
    depends on PCI_ARBITER
    help
        The number of PCI bus request/grant pairs. Should be not
  	be more than 8. Note that the processor needs one, so the
  	minimum should be 2.
endmenu
```

## lib/gaisler/Kconfig
```kconfig
menu "Gaisler"
    source gaisler/can/Kconfig
    source gaisler/leon3/Kconfig
endmenu
```

## lib/gaisler/can/Kconfig
```kconfig
menu "CAN configuration"
menuconfig GRCAN_ENABLE
    bool "Enable GRCAN interface" 
    help
    Say Y here to enable GRCAN core.

config GRCANIRQ
    int "Interrupt number"
    default 13
    depends on GRCAN_ENABLE
    help
    Defines which interrupt number the CAN core will generate.

config GRCANSINGLE
    bool "Enable single common interrupt"
    default n
    depends on GRCAN_ENABLE
    help
    Say Y here to assign one   interrupt  (common).
    Say N here to assign three interrupts (common, txsync, rxsync).

menuconfig CAN_ENABLE
    bool "Enable multi-core CAN interface"
    help
    Say Y here to enable one or more CAN cores. The cores has one
    AHB slave interface for accessing the control registers. The CAN core
    is register-compatible with the SAJ1000 core from Philips, with a
    few exceptions. See the GRLIP IP manual for details.

config CAN_NUM
    int "Number of CAN cores"
    default 1
    depends on CAN_ENABLE
    help
    Number of CAN cores. The module allows up to 8 independent
    CAN cores to be implemented.

config CANIO
    hex "CAN I/O area start address (haddr[19:8])"
    default C00
    depends on CAN_ENABLE
    help
    The control registers of each CAN core occupies 256 bytes, and 
    address space needed for the full module is thus 2 Kbyte. The cores
    are mapped in the AHB bus I/O area (0xFFF00000 - 0xFFFFF000). 
    This setting defines at which address in the I/O area the registers
    appear (HADDR[19:8]).

config CANIRQ
    int "Interrupt number"
    default 13
    depends on CAN_ENABLE
    help
    Defines which interrupt number the CAN core will generate.

config CANSEPIRQ
    bool "Enable separate interrupts"
    default n
    depends on CAN_ENABLE
    help
    Say Y here to assign an individual interrupt to each CAN core,
    starting from the base interrupt number. If set to N, all
    CAN cores will generate the same interrupt.

config CAN_SYNCRST
    bool "Enable synchronous reset"
    default n
    depends on CAN_ENABLE
    help
    If you say Y here, the CAN core will be implemented with
    synchronous reset rather than asynchronous. This is needed
    when the target library does not implement registers with
    async reset. Unless you know what you are doing, say N.

config CAN_FT
    bool "Enable FT FIFO memory"
    default n
    depends on CAN_ENABLE
    help
    If you say Y here, the CAN FIFOs will be implemented using
    SEU protected RAM blocks. Only applicable to the FT version
    of grlib.

menuconfig OCCAN_ENABLE
    bool "Enable CAN interface"
    help
    Say Y here to enable the CAN interace from OpenCores. The core has one
    AHB slave interface for accessing the control registers. The CAN core
    ir register-compatible with the SAJ1000 core from Philips.

config OCCANIO
    hex "CAN I/O area start address (haddr[19:8])"
    default C00
    depends on OCCAN_ENABLE
    help
    The control registers of the CAN core occupy 4 kbyte, and are 
    mapped in the AHB bus I/O area (0xFFF00000 - 0xFFFFF000). This setting
    defines at which address in the I/O area the registers appear (HADDR[19:8]).

config OCCANIRQ
    int "Interrupt number"
    default 13
    depends on OCCAN_ENABLE
    help
    Defines which interrupt number the CAN core will generate.

config OCCANLOOP
    bool "Enable loop-back testing"
    default n
    depends on OCCAN_ENABLE
    help
    If you say Y here, the receiver and trasmitter of the CAN core will
    be connected together in a loop-back fashion. This will make it 
    possible to perform loop-back test, but not data will be sent
    or received from the outside. ONLY for testing!

config OCCAN_SYNCRST
    bool "Enable synchronous reset"
    default n
    depends on OCCAN_ENABLE
    help
    If you say Y here, the CAN core will be implemented with
    synchronous reset rather than asynchronous. This is needed
    when the target library does not implement registers with
    async reset. Unless you know what you are doing, say N.

config OCCAN_FT
    bool "Enable FT FIFO memory"
    default n
    depends on OCCAN_ENABLE
    help
    If you say Y here, the CAN FIFOs will be implemented using
    SEU protected RAM blocks. Only applicable to the FT version
    of grlib.
endmenu
```

## lib/gaisler/leon3/Kconfig
```kconfig
menuconfig STAT_ENABLE
    bool "LEON3 Statistics Module"
    default y
    help
    Say Y here to enable the LEON3 Statistical Unit. The unit consists
    of a number of timers that can count various processor and MMU/FPU
    events to allow analysis of processor behavior and performance.
config STAT_CNT
    int "Number of counters (1 - 64)"
    default 4
    depends on STAT_ENABLE
    help
    Set the number of 32-bit counters in the unit (1 - 32).
config STAT_NMAX
    int "Number of accumulative counters"
    default 0
    depends on STAT_ENABLE
    help
    If this value is higher than 0, the core will include functionality 
    for tracking the longest consecutive time that an event is active or 
    inactive. The functionality will be available for the nmax first 
    counters. This value must not exceed the number of available counters.

menuconfig LEON3
    bool "Enable LEON3 SPARC V8 Processor"
    default y

config PROC_NUM
    int "Number of processors"
    default 1
    depends on LEON3
    help
    The number of processor cores. The LEON3MP design can accomodate
    up to 4 LEON3 processor cores. Use 1 unless you know what you are
    doing ...

choice LEON3_EXAMPLE
    prompt "Force values from example configuration (see help)"
    depends on LEON3
    default LEON3_EXAMPLE_MIN
config LEON3_EXAMPLE_MIN
    bool "Minimal-configuration"
config LEON3_EXAMPLE_GP
    bool "General-purpose-cfg"
config LEON3_EXAMPLE_HP
    bool "High-Performance-cfg"
config LEON3_EXAMPLE_CUSTOM
    bool "Custom-configuration"
endchoice

if LEON3_EXAMPLE_MIN
endif
```

## lib/grlib/Kconfig
```kconfig
menu "GRLIB settings"

     source grlib/amba/Kconfig
     source grlib/util/Kconfig
     source techmap/Kconfig

endmenu
```

## lib/grlib/amba/Kconfig
```kconfig
menu "AMBA configuration"
config  AHB_DEFMST
	int "Default AHB master"
	default 0
	help
		Sets the default AHB master (see AMBA 2.0 specification for definition).
		Should not be set to a value larger than the number of AHB masters - 1.
		For highest processor performance, leave it at 0.
config AHB_RROBIN
       bool "Round-robin arbiter"
       default n
       help
		Say Y here to enable round-robin arbitration of the AHB bus. A N will
  		select fixed priority, with the master with the highest bus index having
  		the highest priority
config AHB_SPLIT
       bool "AHB split-transaction support"
       default y
       help
		Say Y here to enable AHB split-transaction support in the AHB arbiter.
		Unless you actually have an AHB slave that can generate AHB split
		responses, say N and save some gates.
config AHB_FPNPEN
       bool "Enable full plug&play decoding"
       default y
       help
              Say Y here to enable full decoding of the PnP configuration records in
       	      in the AHB arbiter. When disabled the user-defined registers in the
	      PnP configuration records are not mapped in the configuration area
config AHB_IOADDR
       hex "AHB/APB bridge address (haddr[31:20])"
       default FFF
       help
              Selects the MSB adddress (HADDR[31:20]) of the AHB IO area, as defined 
       	      in the plug&play extentions of the AMBA bus. Should be kept to FFF 
       	      unless you really know what you are doing.
config APB_HADDR
       hex "AHB/APB bridge address (haddr[31:20])"
       default 800
       help
              Selects the MSB adddress (HADDR[31:20]) of the APB bridge. Should be
       	      kept at 800 for software compatibility.
config AHB_MON
      bool "Enable AMBA AHB monitor"
      default y
      help
            Say Y to enable the AHB bus monitor. The monitor will check for
            illegal AHB transactions during simulation. It has no impact on
            synthesis.

config AHB_MONERR
      bool "Report AHB errors"
      default y
      depends on AHB_MON
      help
		Print out detected AHB violations on console.
config AHB_MONWAR
      bool "Report AHB warings"
      default y
      depends on AHB_MON
      help 
      	    Print out detected AHB warnings on console.

config AHB_DTRACE
       bool "Write trace to simulation console"
       default n
       help
		Say yes here to write a trace of all AHB transfers to the
		simulator console. Has not impact on final netlist.
endmenu
```

## lib/techmap/Kconfig
```kconfig
menu "Technology mappings"

source techmap/gencomp/Kconfig
source techmap/clocks/Kconfig
endmenu
```
