## lib/techmap/clocks/Kconfig
```kconfig
menu "Clock generator"

choice CLK
    prompt "Clock generator"
    default CLK_INFERRED
    help
    Certain target technologies include clock generators to scale or
    phase-adjust the system and SDRAM clocks. This is currently supported
    for Xilinx, Altera and Proasic3 FPGAs. Depending on technology, you
    can select to use the Xilinx CKLDLL macro (Virtex, VirtexE, Spartan1/2),
    the Xilinx DCM (Virtex-2, Spartan3, Virtex-4), the Xilinx PLLE2 (Virtex-7,
    Kintex-7, Artix-4), the Altera ALTDLL (Stratix, Cyclone), or the 
    Proasic3 PLL. Choose the 'inferred' option to skip a clock generator.
config CLK_INFERRED
    bool "Inferred"
config CLK_HCLKBUF
    bool "Actel-HCLKBUF"
config CLK_UT130HBD
    bool "Aeroflex-UT130HBD"
config CLK_ALTDLL
    bool "Altera-ALTPLL"
config CLK_LATDLL
    bool "Lattice-EXPLL"
config CLK_PRO3PLL
    bool "Proasic3-PLL"
config CLK_PRO3EPLL
    bool "Proasic3E-PLL"
config CLK_PRO3LPLL
    bool "Proasic3L-PLL"
config CLK_FUSPLL
    bool "Fusion-PLL"
config CLK_LIB18T
    bool "RH-LIB18T-PLL"
config CLK_RHUMC
    bool "RHUMC-PLL"
config CLK_DARE
    bool "DARE-PLL"
config CLK_SAED32
    bool "SAED32-PLL"
config CLK_EASIC45
    bool "EASIC45-PLL"
config CLK_RHS65
    bool "RHS65-PLL"
config CLK_CLKPLLE2
    bool "Xilinx-PLLE2"
config CLK_CLKDLL
    bool "Xilinx-CLKDLL"
config CLK_DCM
    bool "Xilinx-DCM"
endchoice

config CLK_MUL
    int "Clock multiplication factor (allowed values are tech dependent)"
    default 2
    depends on CLK_DCM || CLK_ALTDLL || CLK_LATDLL || CLK_PRO3PLL || CLK_PRO3EPLL || CLK_PRO3LPLL || CLK_CLKDLL || CLK_LIB18T || CLK_FUSPLL || CLK_CLKPLLE2
    help
    When using the Xilinx DCM, Xilinx PLLE2 or Altera ALTPLL, 
    the system clock can be multiplied with a factor of 2 - 32, 
    and divided by a factor of 1 - 32. This makes it possible to 
    generate almost any desired processor frequency. When using 
    the Xilinx CLKDLL generator, the resulting frequency scale f
    actor (mul/div) must be one of 1/2, 1 or 2. On Proasic3, 
    the factor can be 1 - 128. 

    WARNING: The resulting clock must be within the limits specified
    by the target FPGA family.

config CLK_DIV
    int "Clock division factor (allowed values are tech dependent)"
    default 2
    depends on CLK_DCM || CLK_ALTDLL || CLK_LATDLL || CLK_PRO3PLL || CLK_PRO3EPLL || CLK_PRO3LPLL || CLK_CLKDLL || CLK_LIB18T || CLK_FUSPLL || CLK_CLKPLLE2
    help
    When using the Xilinx DCM, Xilinx PLLE2 or Altera ALTPLL, 
    the system clock can be multiplied with a factor of 2 - 32, 
    and divided by a factor of 1 - 32. This makes it possible to 
    generate almost any desired processor frequency. When using 
    the Xilinx CLKDLL generator, the resulting frequency scale f
    actor (mul/div) must be one of 1/2, 1 or 2. On Proasic3, 
    the factor can be 1 - 128. 

    WARNING: The resulting clock must be within the limits specified
    by the target FPGA family.

config OCLK_DIV
    int "Outout division factor (1 - 32)"
    default 1
    depends on CLK_PRO3PLL || CLK_PRO3EPLL || CLK_PRO3LPLL || CLK_FUSPLL
    help
    When using the Proasic3 PLL, the system clock is generated by three
    parameters: input clock multiplication, input clock division and
    output clock division. Only certain values of these parameters
    are allowed, but unfortunately this is not documented by Actel.
    To find the correct values, run the Libero Smartgen tool and
    insert you desired input and output clock frequencies in the
    Static PLL configurator. The mul/div factors can then be read
    out from tool.

config OCLKB_DIV
    int "Outout division factor, 2nd clk (0 - 32, see help)"
    default 0
    depends on CLK_PRO3PLL || CLK_PRO3EPLL || CLK_PRO3LPLL || CLK_FUSPLL
    help
    See help for 'Ouput division factor'. Set this to 0 to disable the
    second clock output.

config OCLKC_DIV
    int "Outout division factor, 3rd clk (0 - 32, see help)"
    default 0
    depends on CLK_PRO3PLL || CLK_PRO3EPLL || CLK_PRO3LPLL || CLK_FUSPLL
    help
    See help for 'Ouput division factor'. Set this to 0 to disable the
    third clock output.

config PCI_CLKDLL
    bool "Enable Xilinx CLKDLL for PCI clock"
    default y
    depends on CLK_CLKDLL || CLK_DCM
    help
    Say Y here to re-synchronize the PCI clock using a 
    Virtex BUFGDLL macro. Will improve PCI clock-to-output 
    delays on the expense of input-setup requirements.

config CLK_NOFB
    bool "Disable external feedback for SDRAM clock"
    default n
    depends on CLK_DCM
    help
    Say Y here to disable the external clock feedback to synchronize the
    SDRAM clock. This option is necessary if your board or design does not
    have an external clock feedback that is connected to the pllref input
    of the clock generator.

config PCI_SYSCLK
    bool "Use PCI clock as system clock"
    default n
    depends on PCI_ENABLE
    help
    Say Y here to the PCI clock to generate the system clock.
    The PCI clock can be scaled using the DCM or CLKDLL to 
    generate a suitable processor clock.
endmenu
```

## lib/techmap/gencomp/Kconfig
```kconfig
# menu "Clock"
#
# choice CONFIG_CLK
#     prompt "Clock generator"
#     default CONFIG_CLK_INFERRED
# config CONFIG_CLK_INFERRED
#     bool "Inferred"
#     help
#     Certain target technologies include clock generators to scale or
#     phase-adjust the system and SDRAM clocks. This is currently supported
#     for Xilinx and Altera FPGAs. Depending on technology, you can select
#     to use the Xilinx CKLDLL macro (Virtex, VirtexE, Spartan1/2), the
#     Xilinx DCM (Virtex-2, Spartan3, Virtex-4), or the Altera ALTDLL
#     (Stratix, Cyclone). Choose the 'inferred' option if you are not
#     using Xilinx or Altera FPGAs.

#     Using a technology specific clock generator is necessary to
#     re-syncronize the SDRAM clock. For this to work, connect the
#     external SDCLK signal with PLLREF. 
# config CONFIG_CLK_HCLKBUF
#     bool "Actel-HCLKBUF"
# config CONFIG_CLK_ALTDLL
#     bool "Altera-ALTPLL"
# config CONFIG_CLK_LATDLL
#     bool "Lattice-EXPLL"
# config CONFIG_CLK_LIB18T
#     bool "RH-LIB18T-PLL"
# config CONFIG_CLK_DARE
#     bool "DARE-PLL"
# config CONFIG_CLK_SAED32
#     bool "SAED32-PLL"
# config CONFIG_CLK_RHS65
#     bool "RHS65-PLL"
# config CONFIG_CLK_CLKPLLE2
#     bool "Xilinx-PLLE2"
# config CONFIG_CLK_CLKMMCME3
#     bool "Xilinx-MMCME3"
# config CONFIG_CLK_CLKDLL
#     bool "Xilinx-CLKDLL"
# config CONFIG_CLK_DCM
#     bool "Xilinx-DCM"
# endchoice
# config CONFIG_CLK_MUL
#     int "Clock multiplication factor (2 - 32)"
#     default 2
#     depends on CONFIG_CLK_DCM || CONFIG_CLK_ALTDLL || CONFIG_CLK_LATDLL || CONFIG_CLK_CLKDLL || CONFIG_CLK_LIB18T
#     help
#     When using the Xilinx DCM or Altera ALTPLL, the system clock can
#     be multiplied with a factor of 2 - 32, and divided by a factor of
#     1 - 32. This makes it possible to generate almost any desired 
#     processor frequency. When using the Xilinx CLKDLL generator,
#     the resulting frequency scale factor (mul/div) must be one of
#     1/2, 1 or 2.

#     WARNING: The resulting clock must be within the limits specified
#     by the target FPGA family
# config CONFIG_CLK_DIV
#     int "Clock division factor (2 - 32)"
#     default 2
#     depends on CONFIG_CLK_DCM || CONFIG_CLK_ALTDLL || CONFIG_CLK_LATDLL || CONFIG_CLK_CLKDLL || CONFIG_CLK_LIB18T
#     help
#     When using the Xilinx DCM or Altera ALTPLL, the system clock can
#     be multiplied with a factor of 2 - 32, and divided by a factor of
#     1 - 32. This makes it possible to generate almost any desired 
#     processor frequency. When using the Xilinx CLKDLL generator,
#     the resulting frequency scale factor (mul/div) must be one of
#     1/2, 1 or 2.

#     WARNING: The resulting clock must be within the limits specified
#     by the target FPGA family.
# config CONFIG_PCI_CLKDLL
#     bool "Enable Xilinx CLKDLL for PCI clock"
#     default y
#     depends on CONFIG_CLK_CLKDLL || CONFIG_CLK_DCM
#     help
#     Say Y here to re-synchronize the PCI clock using a 
#     Virtex BUFGDLL macro. Will improve PCI clock-to-output 
#     delays on the expense of input-setup requirements.
# config CONFIG_CLK_NOFB
#     bool "Disable external feedback for SDRAM clock"
#     default n
#     depends on CONFIG_CLK_DCM
#     help
#     Say Y here to disable the external clock feedback to synchronize the
#     SDRAM clock. This option is necessary if your board or design does not
#     have an external clock feedback that is connected to the pllref input
#     of the clock generator.
# config CONFIG_PCI_SYSCLK
#     bool "Use PCI clock as system clock"
#     default n
#     depends on CONFIG_PCI_ENABLE
#     help
#     Say Y here to the PCI clock to generate the system clock.
#     The PCI clock can be scaled using the DCM or CLKDLL to 
#     generate a suitable processor clock.
# endmenu

menu "Technology cells"
choice SYN
    prompt "Target technology"
    default SYN_INFERRED
    help
    Selects the target technology for memory and pads.
    The following are available:

    - Inferred: Generic FPGA or ASIC targets if your synthesis tool
    is capable of inferring RAMs and pads automatically.

    - Actel ProAsic/P/3, IGLOO/2, RTG4 and Axcelerator FPGAs
    - Aeroflex UT25CRH Rad-Hard 0.25 um CMOS
    - Altera: Most Altera FPGA families
    - Altera-CycloneIII: Altera Cyclone-III/IV FPGA family
    - Altera-Stratix: Altera Stratix FPGA family
    - Altera-StratixII: Altera Stratix/Cyclone-II FPGA families
    - Altera-StratixIII: Altera Stratix-III FPGA family
    - Altera-StratixIV: Altera Stratix-IV FPGA family
    - Altera-StratixV: Altera Stratix-V FPGA family
    - ATC18: Atmel-Nantes 0.18 um rad-hard CMOS
    - Lattice : EC/ECP/XP FPGAs
    - Quicklogic : Eclipse/E/II FPGAs
    - UMC-0.18 : UMC 0.18 um CMOS with Virtual Silicon libraries
    - Xilinx-Spartan/2/3/6: Xilinx Spartan/2/3/6 libraries
    - Xilinx-Spartan3E: Xilinx Spartan3E libraries
    - Xilinx-Virtex/E: Xilinx Virtex/E libraries
    - Xilinx-Virtex2/4/5/6/7: Xilinx Virtex2/4/5/6/7 libraries

    Note: Level of technology support depends on type of GRLIB
    distribution. A technology may be present in this list while the
    tech support files are missing from the GRLIB distribution.
    Actel support is only available in commercial and FT distributions.

    Additional target technologies are available that are not selectable
    via the xconfig tool.
config SYN_INFERRED
    bool "Inferred"
config SYN_AXCEL
    bool "Actel-Axcelerator"
config SYN_AXDSP
    bool "Actel-Axcelerator-DSP"
config SYN_PROASIC
    bool "Actel-Proasic"
config SYN_PROASICPLUS
    bool "Actel-ProasicPlus"
config SYN_PROASIC3
    bool "Actel-Proasic3"
config SYN_PROASIC3E
    bool "Actel-Proasic3E"
config SYN_PROASIC3L
    bool "Actel-Proasic3L"
config SYN_IGLOO
    bool "Actel-IGLOO/p/L"
config SYN_IGLOO2
    bool "Actel-IGLOO2"
config SYN_SF2
    bool "Actel-SmartFusion2"
config SYN_RTG4
    bool "Actel-RTG4"
config SYN_FUSION
    bool "Actel-Fusion"
config SYN_UT025CRH
    bool "Aeroflex-UT025CRH"
config SYN_UT130HBD
    bool "Aeroflex-UT130HBD"
config SYN_UT90NHBD
    bool "Aeroflex-UT90NHBD"
config SYN_CYCLONEIII
    bool "Altera-CycloneIII"
config SYN_STRATIX
    bool "Altera-Stratix"
config SYN_STRATIXII
    bool "Altera-StratixII"
config SYN_STRATIXIII
    bool "Altera-StratixIII"
config SYN_STRATIXIV
    bool "Altera-StratixIV"
config SYN_STRATIXV
    bool "Altera-StratixV"
config SYN_ALTERA
    bool "Altera-Others"
config SYN_ATC18
    bool "Atmel-ATC18"
config SYN_ATC18RHA
    bool "Atmel-ATC18RHA"
config SYN_CUSTOM1
    bool "Custom1"
config SYN_DARE
    bool "DARE"
config SYN_CMOS9SF
    bool "IBM-CMOS9SF"
config SYN_LATTICE
    bool "Lattice-EC/ECP/XP"
config SYN_ECLIPSE
    bool "Quicklogic-Eclipse"
config SYN_RH_LIB18T
    bool "RH-LIB18T"
config SYN_RHUMC
    bool "RH-UMC"
config SYN_RHS65
    bool "RHS65"
config SYN_SAED32
    bool "SAED32"
config SYN_SMIC13
    bool "SMIC130"
config SYN_TM65GPLUS
    bool "TM65Gplus"
config SYN_TSMC90
    bool "TSMC90"
config SYN_UMC
    bool "UMC180"
config SYN_ARTIX7
    bool "Xilinx-Artix7"
config SYN_KINTEX7
    bool "Xilinx-Kintex7"
config SYN_KINTEXU
    bool "Xilinx-KintexUltra"
config SYN_SPARTAN3
    bool "Xilinx-Spartan3"
config SYN_SPARTAN3E
    bool "Xilinx-Spartan3E"
config SYN_SPARTAN6
    bool "Xilinx-Spartan6"
config SYN_VIRTEX2
    bool "Xilinx-Virtex2"
config SYN_VIRTEX4
    bool "Xilinx-Virtex4"
config SYN_VIRTEX5
    bool "Xilinx-Virtex5"
config SYN_VIRTEX6
    bool "Xilinx-Virtex6"
config SYN_VIRTEX7
    bool "Xilinx-Virtex7"
config SYN_ZYNQ7000
    bool "Xilinx-Zynq7000"
endchoice

choice MEM
    prompt "Memory library"
    default MEM_INFERRED
    depends on SYN_INFERRED || SYN_CUSTOM1 || SYN_ATC18 || SYN_TSMC90 || SYN_UMC || SYN_RHUMC || SYN_DARE || SYN_SAED32 || SYN_RHS65 || SYN_ARTISAN
config MEM_INFERRED
    bool "Inferred"
config MEM_UMC
    bool "UMC18"
config MEM_RHUMC
    bool "RH-UMC"
config MEM_SAED32
    bool "SAED32"
config MEM_DARE
    bool "DARE"
config MEM_RHS65
    bool "RHS65"
config MEM_ARTISAN
    bool "Artisan"
config MEM_CUSTOM1
    bool "Custom1"
config MEM_VIRAGE
    bool "Virage"
config MEM_VIRAGE90
    bool "Virage-TSMC90"
endchoice

choice TRANS
    prompt "Transceiver type"
    default TRANS_GTP0
    depends on SYN_VIRTEX5 || SYN_VIRTEX6 || SYN_VIRTEX7
config TRANS_GTP0
    bool "GTP0"
config TRANS_GTP1
    bool "GTP1"
config TRANS_GTX0
    bool "GTX0"
config TRANS_GTX1
    bool "GTX1"
config TRANS_GTH0
    bool "GTH0"
config TRANS_GTH1
    bool "GTH1"
endchoice

config SYN_INFER_RAM
    bool "Infer RAM"
    depends on !SYN_INFERRED
    help
    Say Y here if you want the synthesis tool to infer your
    RAM automatically. Say N to directly instantiate technology-
    specific RAM cells for the selected target technology package.

config SYN_INFER_PADS
    bool "Infer pads"
    depends on !SYN_INFERRED
    help
    Say Y here if you want the synthesis tool to infer pads.
    Say N to directly instantiate technology-specific pads from
    the selected target technology package.

config SYN_NO_ASYNC
    bool "Disable asynchronous reset"
    help
    Say Y here if you disable asynchronous reset in some of the IP cores.
    Might be necessary if the target library does not have cells with
    asynchronous set/reset.

config SYN_SCAN
    bool "Enable scan support"
    help
    Say Y here to enable scan support in some cores. This will enable
    the scan support generics where available and add logic to make
    the design testable using full-scan.

endmenu
```
